## esp32s3/sdkconfig.defaults
```kconfig
CONFIG_ESPTOOLPY_FLASHSIZE_16MB=y
CONFIG_FREERTOS_HZ=1000
CONFIG_BOOTLOADER_LOG_LEVEL_NONE=y
# CONFIG_BOOTLOADER_FLASH_XMC_SUPPORT is not set
# CONFIG_BOOTLOADER_WDT_ENABLE is not set
```
